//--------------------------------------------------------------------------------
//	Single Pixel
//
//	Abstract class for settings the brightness for a single LED or other light source
//
//	2021.08.31: Created
//--------------------------------------------------------------------------------
#include "SinglePixel.h"

//---------------------------------------------------------------------------------
//
//	SinglePixel class
//
//---------------------------------------------------------------------------------

//---------------------------------------------------------------------------------
//	Constructure
//---------------------------------------------------------------------------------
SinglePixel::SinglePixel() {
	this->brightness = 0;
}

//---------------------------------------------------------------------------------
//	Destructor
//---------------------------------------------------------------------------------
SinglePixel::~SinglePixel() {
}

//---------------------------------------------------------------------------------
//	Gamma table
//---------------------------------------------------------------------------------
static const uint8_t PROGMEM _NeoPixelGammaTable[256] = {
    0,  0,  0,  0,  0,  0,  0,  0,  0,  0,  0,  0,  0,  0,  0,  0,
    0,  0,  0,  0,  0,  0,  0,  0,  1,  1,  1,  1,  1,  1,  1,  1,
    1,  1,  1,  1,  2,  2,  2,  2,  2,  2,  2,  2,  3,  3,  3,  3,
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  218,220,223,225,227,230,232,235,237,240,242,245,247,250,252,255};
  
//---------------------------------------------------------------------------------
//	Gamma function
//---------------------------------------------------------------------------------
static uint8_t    gamma8(uint8_t x) {
    return pgm_read_byte(&_NeoPixelGammaTable[x]); // 0-255 in, 0-255 out
  }

//---------------------------------------------------------------------------------
//	Set Brightness
//---------------------------------------------------------------------------------
void SinglePixel::setBrightness(uint16_t brightness)
{
	this->brightness = brightness;
	
	uint16_t gbrightness = gamma8(brightness);
	
	if (gbrightness == 0)
		gbrightness = 1;

	this->setBrightnessValue(gbrightness);
}

//---------------------------------------------------------------------------------
//	Set Hue
//---------------------------------------------------------------------------------
void SinglePixel::setHue(uint8_t hue, uint8_t hueRange)
{
	this->hue = hue;
	this->hueRange = hueRange;
}
	   
//---------------------------------------------------------------------------------
//	Set Color
//---------------------------------------------------------------------------------
void SinglePixel::setColor(uint32_t color)
{
	this->color = color;
}

//---------------------------------------------------------------------------------
//
//	Color Utilities
//
//---------------------------------------------------------------------------------

//---------------------------------------------------------------------------------
//	Scale Color
//---------------------------------------------------------------------------------
uint32_t ScaleColor(uint32_t color, uint8_t numerator, uint8_t denominator)
{
	uint32_t clr;
	
	// Multiply each color channel by numerator/denominator
	uint16_t n = numerator;
	uint16_t d = denominator;
	clr  = ((((color >> 16) & 0xff) * n) / d ) << 16;
	clr |= ((((color >>  8) & 0xff) * n) / d ) <<  8;
	clr |= ((((color      ) & 0xff) * n) / d );

	return clr; 
}

//---------------------------------------------------------------------------------
//	Hue to Color
//---------------------------------------------------------------------------------
uint32_t HueToColor(uint16_t hue, uint16_t range /*= 0xff*/, uint8_t brightness /*= 0xff*/)
{
  uint16_t phase = range/3;
  uint16_t r, g, b;

  hue = hue % range;
  
  if (hue < phase)
  {
    r = phase - hue;
    g = 0;
    b = hue;
  }
  else if (hue < 2*phase)
  {
    hue -= phase;
    r = 0;
    g = hue;
    b = phase - hue;
  }
  else
  {
    hue -= 2*phase;
    if (hue > phase)
	    hue = phase;
    r = hue;
    g = phase - hue;
    b = 0;
  }

  r = ((uint32_t)r * brightness)/phase;
  g = ((uint32_t)g * brightness)/phase;
  b = ((uint32_t)b * brightness)/phase;

  return (uint32_t)r << 16 | (uint32_t)g << 8 | b;
}

